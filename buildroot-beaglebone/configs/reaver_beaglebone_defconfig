## buildroot-beaglebone/configs/reaver_beaglebone_defconfig
```kconfig
#
# Unmodified stuff originally from buildroot/configs/beaglebone_defconfig
#

# Architecture
BR2_arm=y
BR2_cortex_a8=y
BR2_ARM_FPU_VFPV3=y

# System
BR2_ROOTFS_DEVICE_CREATION_DYNAMIC_MDEV=y


# Filesystem
BR2_TARGET_ROOTFS_EXT2=y
BR2_TARGET_ROOTFS_EXT2_4=y

# Bootloader (stock, from original file)
BR2_TARGET_UBOOT=y
BR2_TARGET_UBOOT_BUILD_SYSTEM_KCONFIG=y
BR2_TARGET_UBOOT_CUSTOM_VERSION=y
BR2_TARGET_UBOOT_CUSTOM_VERSION_VALUE="2023.04"
BR2_TARGET_UBOOT_BOARD_DEFCONFIG="am335x_evm"
BR2_TARGET_UBOOT_NEEDS_DTC=y
BR2_TARGET_UBOOT_NEEDS_OPENSSL=y
# BR2_TARGET_UBOOT_FORMAT_BIN is not set
BR2_TARGET_UBOOT_FORMAT_IMG=y
BR2_TARGET_UBOOT_SPL=y
BR2_TARGET_UBOOT_SPL_NAME="MLO"

# Required tools to create the SD image
BR2_PACKAGE_HOST_DOSFSTOOLS=y
BR2_PACKAGE_HOST_GENIMAGE=y
BR2_PACKAGE_HOST_MTOOLS=y

# Supporting host tools to build FIT image
BR2_PACKAGE_HOST_UBOOT_TOOLS=y
BR2_PACKAGE_HOST_UBOOT_TOOLS_FIT_SUPPORT=y

#
# Stuff after here was probably modified
#

# Image
BR2_ROOTFS_POST_IMAGE_SCRIPT="support/scripts/genimage.sh"
BR2_ROOTFS_POST_SCRIPT_ARGS="-c $(BR2_EXTERNAL_REAVER_BEAGLEBONE_PATH)/board/reaver/beaglebone/genimage.cfg"

BR2_PACKAGE_OVERRIDE_FILE="$(BR2_EXTERNAL_REAVER_BEAGLEBONE_PATH)/override.mk"

# Kernel
# N.B. Custom source tree set in override.mk
BR2_LINUX_KERNEL_CUSTOM_VERSION=y
BR2_LINUX_KERNEL_CUSTOM_VERSION_VALUE="custom-linux"
BR2_KERNEL_HEADERS_AS_KERNEL=y
BR2_LINUX_KERNEL_CONFIG_FRAGMENT_FILES="$(BR2_EXTERNAL_REAVER_BEAGLEBONE_PATH)/board/reaver/beaglebone/kernel.fragment"
BR2_LINUX_KERNEL=y
BR2_LINUX_KERNEL_DEFCONFIG="omap2plus"
BR2_LINUX_KERNEL_DTS_SUPPORT=y
BR2_LINUX_KERNEL_INTREE_DTS_NAME="ti/omap/am335x-boneblack"
BR2_LINUX_KERNEL_NEEDS_HOST_OPENSSL=y
BR2_LINUX_KERNEL_DTB_OVERLAY_SUPPORT=y # Compile DTB's with -@ so it generates __symbols__ so we can use overlays

# uboot
BR2_TARGET_UBOOT_CONFIG_FRAGMENT_FILES="$(BR2_EXTERNAL_REAVER_BEAGLEBONE_PATH)/board/reaver/beaglebone/u-boot.fragment"

# Misc stuff
BR2_SYSTEM_DHCP="eth0" # Use eth0 for DHCP

BR2_PACKAGE_DROPBEAR=y

BR2_ROOTFS_OVERLAY="$(BR2_EXTERNAL_REAVER_BEAGLEBONE_PATH)/board/reaver/beaglebone/overlay/"
```
