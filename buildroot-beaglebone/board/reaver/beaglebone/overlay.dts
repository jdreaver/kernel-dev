#include <dt-bindings/gpio/gpio.h>

/dts-v1/;
/plugin/;

&{/leds} {
        my-led {
                label = "myled";
                gpios = <&gpio1 12 GPIO_ACTIVE_HIGH>;
		linux,default-trigger = "heartbeat";
		default-state = "off";
        };
};
